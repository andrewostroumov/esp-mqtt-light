## main/Kconfig
```kconfig
menu "Configuration"
	config WIFI_SSID
		string "WIFI SSID"
		help
			Enter the wifi network SSID
	config WIFI_PASSWORD
		string "WIFI PASSWORD"
		help
			Enter the wifi network PASSWORD
	config MQTT_URI
		string "MQTT URI"
		help
			Enter the MQTT uri
    config MQTT_USERNAME
        string "MQTT USERNAME"
        help
            Enter the MQTT USERNAME
    config MQTT_PASSWORD
        string "MQTT PASSWORD"
        help
            Enter the MQTT PASSWORD
endmenu
```
